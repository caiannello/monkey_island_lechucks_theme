/*
 * lechuck85.c
 *
 * This version is optimized to work on a small attiny85 microcontroller rather than the 
 * .ino file version for Arduino. I have one on a solar panel that just plays lechuck theme
 * whenever there's daylight. :)
 *
 * Created: 11/25/2020 2:00:05 PM
 * Author : Craig Iannello
 */

#include <avr/io.h>
#include <avr/pgmspace.h>
#include <avr/interrupt.h>

const uint16_t song[] PROGMEM = {
0x089e,0x02b4,0x0000,0x018c,0x0885,0x0029,0x07d4,0x0081,0x0a9e,0x01ca,0x089e,0x01ac,0x0000,0x00a7,0x0885,0x016c,
0x0000,0x02d2,0x0885,0x0025,0x07d4,0x0206,0x0000,0x02c2,0x07e0,0x002d,0x07e0,0x0050,0x07e0,0x002d,0x07e0,0x001f,
0x0000,0x031d,0x088d,0x002c,0x07bd,0x0085,0x07e0,0x00a2,0x0000,0x0146,0x0a8d,0x01e0,0x088d,0x01d6,0x088d,0x014c,
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0x09d5,0x029c,0x0000,0x020a,0x099e,0x01a2,0x0000,0x0040,0x07d4,0x0088,0x0a86,0x0161,0x0000,0x0236
};

#define SONG_LEN    (sizeof(song)/sizeof(const uint16_t))

volatile uint16_t playing=0;
volatile uint8_t  done=0;

ISR(TIMER0_OVF_vect)
{
  if(playing)
    playing--;
  else
    done=1;
}

void init()
{
  cli();

  DDRB =  0b00000010; // all inputs except PB1 (OCR1A)
  PORTB = 0b00011101; // pull-ups on inputs, except set PB1 low

  // timer 0 for note/rest duration
  TCCR0A = 0x00;
  TCCR0B = 0x02;  // 3906.25 rollovers/sec at 8MHz

  // interrupt on rollover of timer 0
  TIMSK = 1 << TOIE0;

  sei();        // enable interrupts
}

void tone(uint16_t note, uint16_t durr)
{
  cli();

  if(note)
  {
    uint8_t rload  = note&0xff;
    OCR1C = rload;
    OCR1A = rload>>1;
    uint8_t pscale = (uint16_t)note>>8;
    TCCR1 = 0b01100000 | pscale;
  } else
  {
    TCCR1 = 0b01100000;
    GTCCR = 2;
  }

  playing = durr;
  done=0;

  sei();

  while(!done);

}

int main(void)
{
  init();
  while (1)
  {
    for(uint16_t n = 0; n < SONG_LEN ; n+=2)
    {
      uint16_t note = pgm_read_word_near(song+n);
      uint16_t durr = pgm_read_word_near(song+n+1);
      tone(note,durr);
    }
  }
}

